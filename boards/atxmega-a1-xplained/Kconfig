## cpu/sam0_common/Kconfig
```kconfig
# Copyright (c) 2020 HAW Hamburg
#
# This file is subject to the terms and conditions of the GNU Lesser
# General Public License v2.1. See the file LICENSE in the top level
# directory for more details.
#

config CPU_FAMILY_SAM0
    bool
    select CPU_ARCH_CORTEX_M0PLUS
    select HAS_PERIPH_CPUID
    select HAS_PERIPH_FLASHPAGE
    select HAS_PERIPH_FLASHPAGE_RAW
    select HAS_PERIPH_FLASHPAGE_RWEE
    select HAS_PERIPH_GPIO
    select HAS_PERIPH_GPIO_IRQ
    select HAS_PERIPH_I2C_RECONFIGURE
    select HAS_PERIPH_UART_MODECFG
    select HAS_PERIPH_UART_NONBLOCKING
    select HAS_PERIPH_WDT
    select HAS_PERIPH_WDT_CB
    select WDT_WARNING_PERIOD_SUPPORT

if CPU_FAMILY_SAM0

## Common CPU symbols
config CPU_FAMILY
    default "sam0" if CPU_FAMILY_SAM0

rsource "periph/Kconfig"

endif # CPU_FAMILY_SAM0

source "$(RIOTCPU)/cortexm_common/Kconfig"
```

## cpu/sam0_common/periph/Kconfig
```kconfig
# Copyright (c) 2020 HAW Hamburg
#
# This file is subject to the terms and conditions of the GNU Lesser
# General Public License v2.1. See the file LICENSE in the top level
# directory for more details.

config WDT_WARNING_PERIOD
    depends on HAS_PERIPH_WDT_WARNING_PERIOD && KCONFIG_MODULE_PERIPH_WDT
    default 1

config MOD_SAM0_COMMON_PERIPH
    bool
    default y
    depends on TEST_KCONFIG
    help
        SAM0 common peripheral code.

config MOD_PERIPH_RTC_RTT
    bool
    default y if MOD_PERIPH_RTT || MOD_PERIPH_RTC
    depends on TEST_KCONFIG
```

## cpu/samd21/Kconfig
```kconfig
# Copyright (c) 2020 HAW Hamburg
#
# This file is subject to the terms and conditions of the GNU Lesser
# General Public License v2.1. See the file LICENSE in the top level
# directory for more details.
#
config CPU_SERIES_SAMD21
    bool
    select CPU_FAMILY_SAM0
    select HAS_PUF_SRAM

## Common CPU symbols
if CPU_SERIES_SAMD21

config CPU
    default "samd21"

config CPU_SERIES
    default "samd21"

endif # CPU_SERIES_SAMD21

config CPU_MODEL
    default 'samr21g18a' if CPU_MODEL_SAMR21G18A

## CPU Models
config CPU_MODEL_SAMR21G18A
    bool
    select CPU_SERIES_SAMD21

source "$(RIOTCPU)/sam0_common/Kconfig"
```
