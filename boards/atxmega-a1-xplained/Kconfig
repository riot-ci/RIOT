## boards/hifive1/Kconfig
```kconfig
# Copyright (c) 2020 Inria
#
# This file is subject to the terms and conditions of the GNU Lesser
# General Public License v2.1. See the file LICENSE in the top level
# directory for more details.
#

config BOARD
    default "hifive1" if BOARD_HIFIVE1

config BOARD_HIFIVE1
    bool
    default y
    select CPU_MODEL_FE310_G000
    select HAS_PERIPH_RTC
    select HAS_PERIPH_RTT
    select HAS_PERIPH_SPI
    select HAS_PERIPH_TIMER
    select HAS_PERIPH_UART

menu "Hifive1 clock configuration"

choice "Clock source"
prompt "Clock source selection"
default CONFIG_USE_CLOCK_HFXOSC_PLL

config CONFIG_USE_CLOCK_HFXOSC_PLL
bool
prompt "PLL clocked by high frequency external oscillator (HFXOSC)"

config CONFIG_USE_CLOCK_HFXOSC
bool
prompt "Direct High frequency external oscillator (HFXOSC)"

config CONFIG_USE_CLOCK_HFROSC_PLL
bool
prompt "PLL clocked by High frequency internal oscillator (HFXOSC)"

config CONFIG_USE_CLOCK_HFROSC
bool
prompt "Direct High frequency internal oscillator (HFXOSC)"
endchoice

if CONFIG_USE_CLOCK_HFXOSC_PLL
config CONFIG_CLOCK_PLL_F
int
default 39
prompt "F: REFR multiply factor"

config CONFIG_CLOCK_PLL_Q
int
default 1
prompt "Q: VCO divide factor"
endif

if CONFIG_USE_CLOCK_HFROSC_PLL
config CONFIG_CLOCK_DESIRED_FREQUENCY
int
default 320000000
range 1000000 320000000
prompt "Desired clock frequency"
endif

if CONFIG_USE_CLOCK_HFROSC
config CONFIG_CLOCK_HFROSC_TRIM
int
default 6
range 0 31
prompt "TRIM: input frequency multiplier"

config CONFIG_CLOCK_HFROSC_DIV
int
default 1
range 0 63
prompt "DIV: output frequency divider"
endif

endmenu
```

## boards/hifive1b/Kconfig
```kconfig
# Copyright (c) 2020 Inria
#
# This file is subject to the terms and conditions of the GNU Lesser
# General Public License v2.1. See the file LICENSE in the top level
# directory for more details.
#

config BOARD
    default "hifive1b" if BOARD_HIFIVE1B

config BOARD_HIFIVE1B
    bool
    default y
    select CPU_MODEL_FE310_G002
    select HAS_PERIPH_I2C
    select HAS_PERIPH_RTC
    select HAS_PERIPH_RTT
    select HAS_PERIPH_SPI
    select HAS_PERIPH_TIMER
    select HAS_PERIPH_UART
    select HAS_ARDUINO

menu "Hifive1b clock configuration"

choice "Clock source"
prompt "Clock source selection"
default CONFIG_USE_CLOCK_HFXOSC_PLL

config CONFIG_USE_CLOCK_HFXOSC_PLL
bool
prompt "PLL clocked by high frequency external oscillator (HFXOSC)"

config CONFIG_USE_CLOCK_HFXOSC
bool
prompt "Direct High frequency external oscillator (HFXOSC)"

config CONFIG_USE_CLOCK_HFROSC_PLL
bool
prompt "PLL clocked by High frequency internal oscillator (HFXOSC)"

config CONFIG_USE_CLOCK_HFROSC
bool
prompt "Direct High frequency internal oscillator (HFXOSC)"
endchoice

if CONFIG_USE_CLOCK_HFXOSC_PLL
config CONFIG_CLOCK_PLL_F
int
default 39
prompt "F: REFR multiply factor"

config CONFIG_CLOCK_PLL_Q
int
default 1
prompt "Q: VCO divide factor"
endif

if CONFIG_USE_CLOCK_HFROSC_PLL
config CONFIG_CLOCK_DESIRED_FREQUENCY
int
default 320000000
range 1000000 320000000
prompt "Desired clock frequency"
endif

if CONFIG_USE_CLOCK_HFROSC
config CONFIG_CLOCK_HFROSC_TRIM
int
default 6
range 0 31
prompt "TRIM: input frequency multiplier"

config CONFIG_CLOCK_HFROSC_DIV
int
default 1
range 0 63
prompt "DIV: output frequency divider"
endif

endmenu
```

## boards/nucleo-wl55jc/Kconfig
```kconfig
# Copyright (c) 2021 Freie Universität Berlin
#
# This file is subject to the terms and conditions of the GNU Lesser
# General Public License v2.1. See the file LICENSE in the top level
# directory for more details.
#

config BOARD
    default "nucleo-wl55jc" if BOARD_NUCLEO_WL55JC

config BOARD_NUCLEO_WL55JC
    bool
    default y
    select BOARD_COMMON_NUCLEO64
    select CPU_MODEL_STM32WL55JC

    # Put defined MCU peripherals here (in alphabetical order)
    select HAS_PERIPH_I2C
    select HAS_PERIPH_LPUART
    select HAS_PERIPH_RTT
    select HAS_PERIPH_SPI
    select HAS_PERIPH_TIMER
    select HAS_PERIPH_UART

    # Put other features for this board (in alphabetical order)
    select HAS_ARDUINO
    select HAS_RIOTBOOT

menuconfig KCONFIG_USEMODULE_NUCLEO_WL55JC
    bool "Configure NUCLEO_WL55JC"
    depends on BOARD_NUCLEO_WL55JC
    help
        Configure Nucleo WL55JC board using Kconfig.

if KCONFIG_USEMODULE_NUCLEO_WL55JC

config WL55JC_SUBGHZ_DEBUG
    bool "Enable Hardware Debug Pins"
    help
        Enable this to enable HW debug pins. Refer board.c for more info.

endif # KCONFIG_USEMODULE_NUCLEO_WL55JC

source "$(RIOTBOARD)/common/nucleo64/Kconfig"
```

## boards/qn9080dk/Kconfig
```kconfig
# Copyright (c) 2020 iosabi
#
# This file is subject to the terms and conditions of the GNU Lesser
# General Public License v2.1. See the file LICENSE in the top level
# directory for more details.
#

config BOARD
    default "qn9080dk" if BOARD_QN9080DK

config BOARD_QN9080DK
    bool
    default y
    select BOARD_COMMON_QN9080
    select CPU_MODEL_QN9080XHN

    # Put defined MCU peripherals here (in alphabetical order)
    select HAS_PERIPH_GPIO
    select HAS_PERIPH_GPIO_IRQ
```

## boards/sodaq-autonomo/Kconfig
```kconfig
# Copyright (c) 2020 HAW Hamburg
#
# This file is subject to the terms and conditions of the GNU Lesser
# General Public License v2.1. See the file LICENSE in the top level
# directory for more details.

source "$(RIOTBOARD)/common/sodaq/Kconfig"

config BOARD
    default "sodaq-autonomo" if BOARD_SODAQ_AUTONOMO

config BOARD_SODAQ_AUTONOMO
    bool
    default y
    select CPU_MODEL_SAMD21J18A
    select HAS_PERIPH_PWM
    select HAS_ARDUINO_PWM
    select BOARDS_COMMON_SODAQ
```

## boards/sodaq-one/Kconfig
```kconfig
# Copyright (c) 2020 HAW Hamburg
#
# This file is subject to the terms and conditions of the GNU Lesser
# General Public License v2.1. See the file LICENSE in the top level
# directory for more details.

source "$(RIOTBOARD)/common/sodaq/Kconfig"

config BOARD
    default "sodaq-one" if BOARD_SODAQ_ONE

config BOARD_SODAQ_ONE
    bool
    default y
    select CPU_MODEL_SAMD21G18A
    select BOARDS_COMMON_SODAQ
```

## boards/sodaq-sara-aff/Kconfig
```kconfig
# Copyright (c) 2020 HAW Hamburg
#
# This file is subject to the terms and conditions of the GNU Lesser
# General Public License v2.1. See the file LICENSE in the top level
# directory for more details.

source "$(RIOTBOARD)/common/sodaq/Kconfig"

config BOARD
    default "sodaq-sara-aff" if BOARD_SODAQ_SARA_AFF

config BOARD_SODAQ_SARA_AFF
    bool
    default y
    select CPU_MODEL_SAMD21J18A
    select BOARDS_COMMON_SODAQ
```

## boards/wm-200/Kconfig
```kconfig
# Copyright (c) 2020 HAW Hamburg
# Copyright (c) 2021 Gerson Fernando Budle
#
# This file is subject to the terms and conditions of the GNU Lesser
# General Public License v2.1. See the file LICENSE in the top level
# directory for more details.

config BOARD
    default "wm-200" if BOARD_WM_200

config BOARD_WM_200
    bool
    default y
    select CPU_MODEL_XMEGA256A3U
    select HAS_PERIPH_CPUID
    select HAS_PERIPH_GPIO
    select HAS_PERIPH_GPIO_IRQ
    select HAS_PERIPH_NVM
    select HAS_PERIPH_PM
    select HAS_PERIPH_TIMER
    select HAS_PERIPH_TIMER_PERIODIC
    select HAS_PERIPH_UART

    select HAVE_SAUL_GPIO
```

## cpu/atxmega/Kconfig.XMEGAA
```kconfig
## CPU Models
# XMEGA - A1/A1U
config CPU_MODEL_XMEGA64A1
    bool
    select CPU_CORE_ATXMEGA_A1

config CPU_MODEL_XMEGA128A1
    bool
    select CPU_CORE_ATXMEGA_A1

config CPU_MODEL_XMEGA64A1U
    bool
    select CPU_CORE_ATXMEGA_A1

config CPU_MODEL_XMEGA128A1U
    bool
    select CPU_CORE_ATXMEGA_A1

# XMEGA - A3/A3U/A3BU
config CPU_MODEL_XMEGA64A3
    bool
    select CPU_CORE_ATXMEGA_A3

config CPU_MODEL_XMEGA128A3
    bool
    select CPU_CORE_ATXMEGA_A3

config CPU_MODEL_XMEGA192A3
    bool
    select CPU_CORE_ATXMEGA_A3

config CPU_MODEL_XMEGA256A3
    bool
    select CPU_CORE_ATXMEGA_A3

config CPU_MODEL_XMEGA64A3U
    bool
    select CPU_CORE_ATXMEGA_A3

config CPU_MODEL_XMEGA128A3U
    bool
    select CPU_CORE_ATXMEGA_A3

config CPU_MODEL_XMEGA192A3U
    bool
    select CPU_CORE_ATXMEGA_A3

config CPU_MODEL_XMEGA256A3U
    bool
    select CPU_CORE_ATXMEGA_A3

config CPU_MODEL_XMEGA256A3BU
    bool
    select CPU_CORE_ATXMEGA_A3

# XMEGA - A4/A4U
config CPU_MODEL_XMEGA16A4
    bool
    select CPU_CORE_ATXMEGA_A4

config CPU_MODEL_XMEGA32A4
    bool
    select CPU_CORE_ATXMEGA_A4

config CPU_MODEL_XMEGA16A4U
    bool
    select CPU_CORE_ATXMEGA_A4

config CPU_MODEL_XMEGA32A4U
    bool
    select CPU_CORE_ATXMEGA_A4

config CPU_MODEL_XMEGA64A4U
    bool
    select CPU_CORE_ATXMEGA_A4

config CPU_MODEL_XMEGA128A4U
    bool
    select CPU_CORE_ATXMEGA_A4

config CPU_MODEL
    string
    default "atxmega64A1"    if CPU_MODEL_XMEGA64A1
    default "atxmega128A1"   if CPU_MODEL_XMEGA128A1
    default "atxmega192A1"   if CPU_MODEL_XMEGA192A1
    default "atxmega256A1"   if CPU_MODEL_XMEGA256A1
    default "atxmega64A1U"   if CPU_MODEL_XMEGA64A1U
    default "atxmega128A1U"  if CPU_MODEL_XMEGA128A1U

    default "atxmega64A3"    if CPU_MODEL_XMEGA64A3
    default "atxmega128A3"   if CPU_MODEL_XMEGA128A3
    default "atxmega192A3"   if CPU_MODEL_XMEGA192A3
    default "atxmega256A3"   if CPU_MODEL_XMEGA256A3
    default "atxmega64A3U"   if CPU_MODEL_XMEGA64A3U
    default "atxmega128A3U"  if CPU_MODEL_XMEGA128A3U
    default "atxmega192A3U"  if CPU_MODEL_XMEGA192A3U
    default "atxmega256A3U"  if CPU_MODEL_XMEGA256A3U
    default "atxmega256A3BU" if CPU_MODEL_XMEGA256A3BU

    default "atxmega16A4"    if CPU_MODEL_XMEGA16A4
    default "atxmega32A4"    if CPU_MODEL_XMEGA32A4
    default "atxmega16A4U"   if CPU_MODEL_XMEGA16A4U
    default "atxmega32A4U"   if CPU_MODEL_XMEGA32A4U
    default "atxmega64A4U"   if CPU_MODEL_XMEGA64A4U
    default "atxmega128A4U"  if CPU_MODEL_XMEGA128A4U
```

## cpu/atxmega/Kconfig.XMEGAB
```kconfig
## CPU Models
# XMEGA - B1
config CPU_MODEL_XMEGA64B1
    bool
    select CPU_CORE_ATXMEGA_B1

config CPU_MODEL_XMEGA128B1
    bool
    select CPU_CORE_ATXMEGA_B1

# XMEGA - B3
config CPU_MODEL_XMEGA64B3
    bool
    select CPU_CORE_ATXMEGA_B3

config CPU_MODEL_XMEGA128B3
    bool
    select CPU_CORE_ATXMEGA_B3

config CPU_MODEL
    default "atxmega64B3"    if CPU_MODEL_XMEGA64B3
    default "atxmega128B3"   if CPU_MODEL_XMEGA128B3

    default "atxmega64B1"    if CPU_MODEL_XMEGA64B1
    default "atxmega128B1"   if CPU_MODEL_XMEGA128B1
```

## cpu/atxmega/Kconfig.XMEGAC
```kconfig
## CPU Models
# XMEGA - C3
config CPU_MODEL_XMEGA32C3
    bool
    select CPU_CORE_ATXMEGA_C3

config CPU_MODEL_XMEGA64C3
    bool
    select CPU_CORE_ATXMEGA_C3

config CPU_MODEL_XMEGC128C3
    bool
    select CPU_CORE_ATXMEGA_C3

config CPU_MODEL_XMEGC192C3
    bool
    select CPU_CORE_ATXMEGA_C3

config CPU_MODEL_XMEGA256C3
    bool
    select CPU_CORE_ATXMEGA_C3

config CPU_MODEL_XMEGA384C3
    bool
    select CPU_CORE_ATXMEGA_C3

# XMEGA - C4
config CPU_MODEL_XMEGA16C4
    bool
    select CPU_CORE_ATXMEGA_C4

config CPU_MODEL_XMEGA32C4
    bool
    select CPU_CORE_ATXMEGA_C4

config CPU_MODEL
    default "atxmega32C3"    if CPU_MODEL_XMEGA32C3
    default "atxmega64C3"    if CPU_MODEL_XMEGA64C3
    default "atxmega128C3"   if CPU_MODEL_XMEGC128C3
    default "atxmega192C3"   if CPU_MODEL_XMEGC192C3
    default "atxmega256C3"   if CPU_MODEL_XMEGA256C3
    default "atxmega384C3"   if CPU_MODEL_XMEGA384C3

    default "atxmega16C4"    if CPU_MODEL_XMEGA16C4
    default "atxmega32C4"    if CPU_MODEL_XMEGA32C4
```

## cpu/atxmega/Kconfig.XMEGAD
```kconfig
## CPU Models
# XMEGA - D3
config CPU_MODEL_XMEGA32D3
    bool
    select CPU_CORE_ATXMEGA_D3

config CPU_MODEL_XMEGA64D3
    bool
    select CPU_CORE_ATXMEGA_D3

config CPU_MODEL_XMEGC128D3
    bool
    select CPU_CORE_ATXMEGA_D3

config CPU_MODEL_XMEGC192D3
    bool
    select CPU_CORE_ATXMEGA_D3

config CPU_MODEL_XMEGA256D3
    bool
    select CPU_CORE_ATXMEGA_D3

config CPU_MODEL_XMEGA384D3
    bool
    select CPU_CORE_ATXMEGA_D3

# XMEGA - D4
config CPU_MODEL_XMEGA16D4
    bool
    select CPU_CORE_ATXMEGA_D4

config CPU_MODEL_XMEGA32D4
    bool
    select CPU_CORE_ATXMEGA_D4

config CPU_MODEL_XMEGA64D4
    bool
    select CPU_CORE_ATXMEGA_D4

config CPU_MODEL_XMEGA128D4
    bool
    select CPU_CORE_ATXMEGA_D4

config CPU_MODEL
    default "atxmega32D3"    if CPU_MODEL_XMEGA32D3
    default "atxmega64D3"    if CPU_MODEL_XMEGA64D3
    default "atxmega128D3"   if CPU_MODEL_XMEGC128D3
    default "atxmega192D3"   if CPU_MODEL_XMEGC192D3
    default "atxmega256D3"   if CPU_MODEL_XMEGA256D3
    default "atxmega384D3"   if CPU_MODEL_XMEGA384D3

    default "atxmega16D4"    if CPU_MODEL_XMEGA16D4
    default "atxmega32D4"    if CPU_MODEL_XMEGA32D4
    default "atxmega64D4"    if CPU_MODEL_XMEGA64D4
    default "atxmega128D4"   if CPU_MODEL_XMEGA128D4
```

## cpu/atxmega/Kconfig.XMEGAE
```kconfig
## CPU Models
config CPU_MODEL_XMEGA8E5
    bool
    select CPU_CORE_ATXMEGA_E5

config CPU_MODEL_XMEGA16E5
    bool
    select CPU_CORE_ATXMEGA_E5

config CPU_MODEL_XMEGA32E5
    bool
    select CPU_CORE_ATXMEGA_E5

config CPU_MODEL
    default "atxmega8E5"     if CPU_MODEL_XMEGA8E5
    default "atxmega16E5"    if CPU_MODEL_XMEGA16E5
    default "atxmega32E5"    if CPU_MODEL_XMEGA32E5
```

## cpu/avr8_common/Kconfig
```kconfig
# Copyright (c) 2020 HAW Hamburg
#               2021 Gerson Fernando Budke
#
# This file is subject to the terms and conditions of the GNU Lesser
# General Public License v2.1. See the file LICENSE in the top level
# directory for more details.
#

config CPU_ARCH_AVR8
    bool
    select HAS_ARCH_8BIT
    select HAS_ARCH_AVR8

config CPU_ARCH_AVR8_NESTED_ISR
    bool "Enable AVR-8 nested interrupts"
    help
        ATmega requires that user re-enebale interrupt inside ISR handle to
        allow nested interrupts.  ATxmega has a specialized controller to allow
        three interrupt levels: low, mid, high.  The controller automatically
        prioritize according to level and vector address.  The round-robin
        priority scheme within low-level interrupts can be enable to avoid
        starvation at low level.

## Common CPU symbols
config CPU_ARCH
    default "avr8" if CPU_ARCH_AVR8

config CPU_CORE
    default "avr" if CPU_CORE_AVR

## Declaration of specific features
config HAS_ARCH_AVR8
    bool
    help
        Indicates that the current architecture is Atmel AVR8.
```

## cpu/esp_common/Kconfig
```kconfig
# Copyright (c) 2020 HAW Hamburg
#
# This file is subject to the terms and conditions of the GNU Lesser
# General Public License v2.1. See the file LICENSE in the top level
# directory for more details.

config CPU_ARCH_XTENSA
    bool
    select HAS_ARCH_32BIT

config CPU_COMMON_ESP
    bool
    select HAS_CPP
    select HAS_PERIPH_CPUID
    select HAS_PERIPH_HWRNG
    select HAS_PERIPH_PM
    select HAS_PERIPH_TIMER
    select HAS_SSP

## Declaration of specific features
config HAS_ESP_SPIFFS
    bool
    help
        Indicates that a Serial Peripheral Interface Flash File System can be
        used.

config HAS_ESP_WIFI
    bool
    help
        Indicates that an ESP WiFi radio is present.

config HAS_ESP_NOW
    bool
    help
        Indicates that an ESP NOW-compatible radio is present.

## Common CPU symbols
config CPU_ARCH
    default "xtensa" if CPU_ARCH_XTENSA
```
