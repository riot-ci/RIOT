## boards/atxmega-a1-xplained/Kconfig
```kconfig
# Copyright (c) 2020 HAW Hamburg
# Copyright (c) 2021 Gerson Fernando Budle
#
# This file is subject to the terms and conditions of the GNU Lesser
# General Public License v2.1. See the file LICENSE in the top level
# directory for more details.

config BOARD
    default "atxmega-a1-xplained" if BOARD_ATXMEGA_A1_XPLAINED

config BOARD_ATXMEGA_A1_XPLAINED
    bool
    default y
    select CPU_MODEL_ATXMEGA128A1
    select HAS_PERIPH_CPUID
    select HAS_PERIPH_RTC
    select HAS_PERIPH_RTT
    select HAS_PERIPH_SPI
    select HAS_PERIPH_TIMER
    select HAS_PERIPH_UART
    select HAS_PERIPH_GPIO
```

## boards/atxmega-a1-xpro/Kconfig
```kconfig
# Copyright (c) 2020 HAW Hamburg
# Copyright (c) 2021 Gerson Fernando Budle
#
# This file is subject to the terms and conditions of the GNU Lesser
# General Public License v2.1. See the file LICENSE in the top level
# directory for more details.

config BOARD
    default "atxmega-a1-xpro" if BOARD_ATXMEGA_A1_XPRO

config BOARD_ATXMEGA_A1_XPRO
    bool
    default y
    select CPU_MODEL_ATXMEGA128A1U
    select HAS_PERIPH_CPUID
    select HAS_PERIPH_RTC
    select HAS_PERIPH_RTT
    select HAS_PERIPH_SPI
    select HAS_PERIPH_TIMER
    select HAS_PERIPH_UART
    select HAS_PERIPH_GPIO
    select HAS_PERIPH_GPIO_IRQ
```

## boards/common/qn908x/Kconfig
```kconfig
# Copyright (c) 2020 iosabi
#
# This file is subject to the terms and conditions of the GNU Lesser
# General Public License v2.1. See the file LICENSE in the top level
# directory for more details.

config BOARD_COMMON_QN9080
    bool
    # Add common board support here.
```

## boards/common/stm32/Kconfig.f0f1f3
```kconfig
# Copyright (c) 2020 Inria
#
# This file is subject to the terms and conditions of the GNU Lesser
# General Public License v2.1. See the file LICENSE in the top level
# directory for more details.
#

menu "STM32 F0 clock configuration"
    depends on CPU_FAM_F0

choice
bool "Clock source selection"
default USE_CLOCK_PLL

config USE_CLOCK_PLL
    bool "Use PLL as system clock"

config USE_CLOCK_HSE
    bool "Use HSE as system clock"
    depends on BOARD_HAS_HSE

config USE_CLOCK_HSI
    bool "Use HSI as system clock"

endchoice

if USE_CLOCK_PLL
config CLOCK_PLL_PREDIV
    int "PLLIN division factor"
    default 1
    range 1 16

config CLOCK_PLL_MUL
    int "PLLIN multiply factor"
    default 6
    range 2 16
endif

choice
bool "APB prescaler (division factor of HCLK to produce PCLK)"
default CLOCK_APB1_DIV_1

config CLOCK_APB1_DIV_1
    bool "Divide HCLK by 1"

config CLOCK_APB1_DIV_2
    bool "Divide HCLK by 2"

config CLOCK_APB1_DIV_4
    bool "Divide HCLK by 4"

config CLOCK_APB1_DIV_8
    bool "Divide HCLK by 8"

config CLOCK_APB1_DIV_16
    bool "Divide HCLK by 16"

endchoice

config CLOCK_APB1_DIV
    int
    default 1 if CLOCK_APB1_DIV_1
    default 2 if CLOCK_APB1_DIV_2
    default 4 if CLOCK_APB1_DIV_4
    default 8 if CLOCK_APB1_DIV_8
    default 16 if CLOCK_APB1_DIV_16

endmenu

source "$(RIOTBOARD)/common/stm32/Kconfig"
```

## boards/common/stm32/Kconfig.f2f4f7
```kconfig
# Copyright (c) 2020 Inria
#
# This file is subject to the terms and conditions of the GNU Lesser
# General Public License v2.1. See the file LICENSE in the top level
# directory for more details.
#

config CLOCK_MAX_84MHZ
    bool
    help
        Indicates that the CPU max core clock frequency is 84MHz

config CLOCK_MAX_96MHZ
    bool
    help
        Indicates that the CPU max core clock frequency is 96MHz

config CLOCK_MAX_100MHZ
    bool
    help
        Indicates that the CPU max core clock frequency is 100MHz

config CLOCK_MAX_120MHZ
    bool
    help
        Indicates that the CPU max core clock frequency is 120MHz

config CLOCK_MAX_168MHZ
    bool
    help
        Indicates that the CPU max core clock frequency is 168MHz

config CLOCK_MAX_180MHZ
    bool
    help
        Indicates that the CPU max core clock frequency is 180MHz

config CLOCK_MAX_216MHZ
    bool
    help
        Indicates that the CPU max core clock frequency is 216MHz

config BOARD_USE_HSE_12MHZ
    bool
    help
        Indicates that the board uses a 12MHz HSE

config BOARD_USE_HSE_16MHZ
    bool
    help
        Indicates that the board uses a 16MHz HSE

config BOARD_USE_HSE_25MHZ
    bool
    help
        Indicates that the board uses a 25MHz HSE

menu "STM32 F2/F4/F7 clock configuration"
    depends on CPU_FAM_F2 || CPU_FAM_F4 || CPU_FAM_F7

choice
bool "Clock source selection"
default USE_CLOCK_PLL

config USE_CLOCK_PLL
    bool "Use PLL as system clock"

config USE_CLOCK_HSE
    bool "Use HSE as system clock"
    depends on BOARD_HAS_HSE

config USE_CLOCK_HSI
    bool "Use HSI as system clock"

endchoice

config CLOCK_PLL_M
    int "Division factor (PLLM) for the main PLL input clock" if USE_CLOCK_PLL
    default 12 if BOARD_USE_HSE_12MHZ
    default 25 if BOARD_USE_HSE_25MHZ
    default 4 if !BOARD_USE_HSE_12MHZ && !BOARD_USE_HSE_25MHZ
    range 2 63

config CLOCK_PLL_N
    int "Main PLL multiplication factor (PLLN) for VCO" if USE_CLOCK_PLL
    default 84 if BOARD_HAS_HSE && CLOCK_MAX_84MHZ
    default 42 if !BOARD_HAS_HSE && CLOCK_MAX_84MHZ
    default 192 if BOARD_HAS_HSE && CLOCK_MAX_96MHZ && BOARD_USE_HSE_25MHZ
    default 96 if BOARD_HAS_HSE && CLOCK_MAX_96MHZ
    default 48 if !BOARD_HAS_HSE && CLOCK_MAX_96MHZ
    default 100 if BOARD_HAS_HSE && CLOCK_MAX_100MHZ
    default 50 if !BOARD_HAS_HSE && CLOCK_MAX_100MHZ
    default 120 if BOARD_HAS_HSE && CLOCK_MAX_120MHZ
    default 60 if !BOARD_HAS_HSE && CLOCK_MAX_120MHZ
    default 336 if BOARD_HAS_HSE && CLOCK_MAX_168MHZ && BOARD_USE_HSE_12MHZ
    default 84 if BOARD_HAS_HSE && CLOCK_MAX_168MHZ && BOARD_USE_HSE_16MHZ
    default 168 if BOARD_HAS_HSE && CLOCK_MAX_168MHZ
    default 84 if !BOARD_HAS_HSE && CLOCK_MAX_168MHZ
    default 180 if BOARD_HAS_HSE && CLOCK_MAX_180MHZ
    default 90 if !BOARD_HAS_HSE && CLOCK_MAX_180MHZ
    default 432 if BOARD_HAS_HSE && CLOCK_MAX_216MHZ && BOARD_USE_HSE_25MHZ
    default 216 if BOARD_HAS_HSE && CLOCK_MAX_216MHZ
    default 108 if !BOARD_HAS_HSE && CLOCK_MAX_216MHZ
    range 50 432

choice
bool "Main PLL division factor (PLLP) for main system clock" if USE_CLOCK_PLL
default PLL_P_DIV_2

config PLL_P_DIV_2
    bool "Divide by 2"

config PLL_P_DIV_4
    bool "Divide by 4"

config PLL_P_DIV_6
    bool "Divide by 6"

config PLL_P_DIV_8
    bool "Divide by 8"

endchoice

config CLOCK_PLL_P
    int
    default 2 if PLL_P_DIV_2
    default 4 if PLL_P_DIV_4
    default 6 if PLL_P_DIV_6
    default 8 if PLL_P_DIV_8

config CLOCK_PLL_Q
    int "Main PLL division factor (PLLQ) for USB OTG FS, and SDIO clocks" if USE_CLOCK_PLL
    default 8
    range 2 15

choice
bool "APB1 prescaler (division factor of HCLK to produce PCLK1)"
default CLOCK_APB1_DIV_2

config CLOCK_APB1_DIV_1
    bool "Divide HCLK by 1"

config CLOCK_APB1_DIV_2
    bool "Divide HCLK by 2"

config CLOCK_APB1_DIV_4
    bool "Divide HCLK by 4"

config CLOCK_APB1_DIV_8
    bool "Divide HCLK by 8"

config CLOCK_APB1_DIV_16
    bool "Divide HCLK by 16"

endchoice

config CLOCK_APB1_DIV
    int
    default 1 if CLOCK_APB1_DIV_1
    default 2 if CLOCK_APB1_DIV_2
    default 4 if CLOCK_APB1_DIV_4
    default 8 if CLOCK_APB1_DIV_8
    default 16 if CLOCK_APB1_DIV_16

choice
bool "APB2 prescaler (division factor of HCLK to produce PCLK2)"
default CLOCK_APB2_DIV_1

config CLOCK_APB2_DIV_1
    bool "Divide HCLK by 1"

config CLOCK_APB2_DIV_2
    bool "Divide HCLK by 2"

config CLOCK_APB2_DIV_4
    bool "Divide HCLK by 4"

config CLOCK_APB2_DIV_8
    bool "Divide HCLK by 8"

config CLOCK_APB2_DIV_16
    bool "Divide HCLK by 16"

endchoice

config CLOCK_APB2_DIV
    int
    default 1 if CLOCK_APB2_DIV_1
    default 2 if CLOCK_APB2_DIV_2
    default 4 if CLOCK_APB2_DIV_4
    default 8 if CLOCK_APB2_DIV_8
    default 16 if CLOCK_APB2_DIV_16

endmenu

source "$(RIOTBOARD)/common/stm32/Kconfig"
```

## boards/common/stm32/Kconfig.l0l1
```kconfig
# Copyright (c) 2020 Inria
#
# This file is subject to the terms and conditions of the GNU Lesser
# General Public License v2.1. See the file LICENSE in the top level
# directory for more details.
#

menu "STM32 L0/L1 clock configuration"
    depends on CPU_FAM_L0 || CPU_FAM_L1

choice
bool "Clock source selection"
default USE_CLOCK_PLL

config USE_CLOCK_PLL
    bool "Use PLL"

config USE_CLOCK_MSI
    bool "Use direct multi-speed frequency internal oscillator (MSI)"

config USE_CLOCK_HSE
    bool "Use direct High frequency external oscillator (HSE)"
    depends on BOARD_HAS_HSE

config USE_CLOCK_HSI
    bool "Use direct High frequency internal oscillator (HSI16)"

endchoice

if USE_CLOCK_PLL
choice
bool "Main PLL division factor"
default PLL_DIV_2

config PLL_DIV_2
    bool "Divide by 2"

config PLL_DIV_3
    bool "Divide by 3"

config PLL_DIV_4
    bool "Divide by 4"

endchoice

config CLOCK_PLL_DIV
    int
    default 2 if PLL_DIV_2
    default 3 if PLL_DIV_3
    default 4 if PLL_DIV_4

choice
bool "Main PLL multiply factor"
default PLL_MUL_4

config PLL_MUL3
    bool "Multiply by 3"

config PLL_MUL_4
    bool "Multiply by 4"

config PLL_MUL_6
    bool "Multiply by 6"

config PLL_MUL_8
    bool "Multiply by 8"

config PLL_MUL_12
    bool "Multiply by 12"

config PLL_MUL_16
    bool "Multiply by 16"

config PLL_MUL_24
    bool "Multiply by 24"

config PLL_MUL_32
    bool "Multiply by 32"

config PLL_MUL_48
    bool "Multiply by 48"

endchoice

config CLOCK_PLL_MUL
    int
    default 3 if PLL_MUL_3
    default 4 if PLL_MUL_4
    default 3 if PLL_MUL_6
    default 8 if PLL_MUL_8
    default 12 if PLL_MUL_12
    default 16 if PLL_MUL_16
    default 24 if PLL_MUL_24
    default 32 if PLL_MUL_32
    default 48 if PLL_MUL_48
endif

if USE_CLOCK_MSI
choice
bool "Desired MSI clock frequency"
default CLOCK_MSI_4MHZ

config CLOCK_MSI_65KHZ
    bool "65.536kHz"

config CLOCK_MSI_130KHZ
    bool "131.072kHz"

config CLOCK_MSI_260KHZ
    bool "262.144kHz"

config CLOCK_MSI_520KHZ
    bool "524.288kHz"

config CLOCK_MSI_1MHZ
    bool "1.048MHz"

config CLOCK_MSI_2MHZ
    bool "2.097MHz"

config CLOCK_MSI_4MHZ
    bool "4.194MHz"

endchoice

config CLOCK_MSI
    int
    default 65536 if CLOCK_MSI_65KHZ
    default 131072 if CLOCK_MSI_130KHZ
    default 262144 if CLOCK_MSI_260KHZ
    default 524288 if CLOCK_MSI_520KHZ
    default 1048000 if CLOCK_MSI_1MHZ
    default 2097000 if CLOCK_MSI_2MHZ
    default 4194000 if CLOCK_MSI_4MHZ
endif

choice
bool "APB1 prescaler (division factor of HCLK to produce PCLK1)"
default CLOCK_APB1_DIV_1

config CLOCK_APB1_DIV_1
    bool "Divide HCLK by 1"

config CLOCK_APB1_DIV_2
    bool "Divide HCLK by 2"

config CLOCK_APB1_DIV_4
    bool "Divide HCLK by 4"

config CLOCK_APB1_DIV_8
    bool "Divide HCLK by 8"

config CLOCK_APB1_DIV_16
    bool "Divide HCLK by 16"

endchoice

config CLOCK_APB1_DIV
    int
    default 1 if CLOCK_APB1_DIV_1
    default 2 if CLOCK_APB1_DIV_2
    default 4 if CLOCK_APB1_DIV_4
    default 8 if CLOCK_APB1_DIV_8
    default 16 if CLOCK_APB1_DIV_16

choice
bool "APB2 prescaler (division factor of HCLK to produce PCLK2)"
default CLOCK_APB2_DIV_1

config CLOCK_APB2_DIV_1
    bool "Divide HCLK by 1"

config CLOCK_APB2_DIV_2
    bool "Divide HCLK by 2"

config CLOCK_APB2_DIV_4
    bool "Divide HCLK by 4"

config CLOCK_APB2_DIV_8
    bool "Divide HCLK by 8"

config CLOCK_APB2_DIV_16
    bool "Divide HCLK by 16"

endchoice

config CLOCK_APB2_DIV
    int
    default 1 if CLOCK_APB2_DIV_1
    default 2 if CLOCK_APB2_DIV_2
    default 4 if CLOCK_APB2_DIV_4
    default 8 if CLOCK_APB2_DIV_8
    default 16 if CLOCK_APB2_DIV_16

endmenu

source "$(RIOTBOARD)/common/stm32/Kconfig"
```

## boards/common/stm32/Kconfig.l4
```kconfig
# Copyright (c) 2020 Inria
#
# This file is subject to the terms and conditions of the GNU Lesser
# General Public License v2.1. See the file LICENSE in the top level
# directory for more details.
#

menu "STM32 L4/WB clock configuration"
    depends on CPU_FAM_L4 || CPU_FAM_WB

choice
bool "Clock source selection"
default USE_CLOCK_PLL

config USE_CLOCK_PLL
    bool "Select PLL as system clock"

config USE_CLOCK_MSI
    bool "Select MSI as system clock"

config USE_CLOCK_HSE
    bool "Select HSE (High Speed External) oscillator as system clock"
    depends on BOARD_HAS_HSE

config USE_CLOCK_HSI
    bool "Select HSI16 (High Speed Internal) oscillator as system clock"

endchoice

if USE_CLOCK_PLL
choice
bool "Source clock for PLL"
default CLOCK_PLL_SRC_MSI if !BOARD_HAS_HSE
default CLOCK_PLL_SRC_HSE if BOARD_HAS_HSE

config CLOCK_PLL_SRC_MSI
    bool "Use MSI source clock"

config CLOCK_PLL_SRC_HSE
    bool "Use HSE source clock"
    depends on BOARD_HAS_HSE

config CLOCK_PLL_SRC_HSI
    bool "Use HSI16 source clock"
endchoice
endif

if USE_CLOCK_MSI || (USE_CLOCK_PLL && CLOCK_PLL_SRC_MSI)
choice
bool "Desired MSI clock frequency"
default CLOCK_MSI_48MHZ

config CLOCK_MSI_100KHZ
    bool "100kHz"

config CLOCK_MSI_200KHZ
    bool "200kHz"

config CLOCK_MSI_400KHZ
    bool "400kHz"

config CLOCK_MSI_800KHZ
    bool "800kHz"

config CLOCK_MSI_1MHZ
    bool "1MHz"

config CLOCK_MSI_2MHZ
    bool "2MHz"

config CLOCK_MSI_4MHZ
    bool "4MHz"

config CLOCK_MSI_8MHZ
    bool "8MHz"

config CLOCK_MSI_16MHZ
    bool "16MHz"

config CLOCK_MSI_24MHZ
    bool "24MHz"

config CLOCK_MSI_32MHZ
    bool "32MHz"

config CLOCK_MSI_48MHZ
    bool "48MHz"

endchoice

config CLOCK_MSI
    int
    default 100000 if CLOCK_MSI_100KHZ
    default 200000 if CLOCK_MSI_200KHZ
    default 400000 if CLOCK_MSI_400KHZ
    default 800000 if CLOCK_MSI_800KHZ
    default 1000000 if CLOCK_MSI_1MHZ
    default 2000000 if CLOCK_MSI_2MHZ
    default 4000000 if CLOCK_MSI_4MHZ
    default 8000000 if CLOCK_MSI_8MHZ
    default 16000000 if CLOCK_MSI_16MHZ
    default 24000000 if CLOCK_MSI_24MHZ
    default 32000000 if CLOCK_MSI_32MHZ
    default 48000000 if CLOCK_MSI_48MHZ

endif

if USE_CLOCK_PLL
config CLOCK_PLL_M
    int "M: Division factor 'M' for the main PLL input clock"
    default 6 if !BOARD_HAS_HSE
    default 5 if BOARD_HAS_HSE
    range 1 8

config CLOCK_PLL_N
    int "Main PLL multiplication factor 'N' for VCO"
    default 20
    range 8 86

choice
bool "Main PLL division factor 'R' for PLLCLK (system clock)"
default PLL_R_DIV_2

config PLL_R_DIV_2
    bool "Divide by 2"

config PLL_R_DIV_4
    bool "Divide by 4"

config PLL_R_DIV_6
    bool "Divide by 6"

config PLL_R_DIV_8
    bool "Divide by 8"

endchoice

config CLOCK_PLL_R
    int
    default 2 if PLL_R_DIV_2
    default 4 if PLL_R_DIV_4
    default 6 if PLL_R_DIV_6
    default 8 if PLL_R_DIV_8
endif  # USE_CLOCK_PLL

choice
bool "APB1 prescaler (division factor of HCLK to produce PCLK1)"
default CLOCK_APB1_DIV_4

config CLOCK_APB1_DIV_1
    bool "Divide HCLK by 1"

config CLOCK_APB1_DIV_2
    bool "Divide HCLK by 2"

config CLOCK_APB1_DIV_4
    bool "Divide HCLK by 4"

config CLOCK_APB1_DIV_8
    bool "Divide HCLK by 8"

config CLOCK_APB1_DIV_16
    bool "Divide HCLK by 16"

endchoice

config CLOCK_APB1_DIV
    int
    default 1 if CLOCK_APB1_DIV_1
    default 2 if CLOCK_APB1_DIV_2
    default 4 if CLOCK_APB1_DIV_4
    default 8 if CLOCK_APB1_DIV_8
    default 16 if CLOCK_APB1_DIV_16

choice
bool "APB2 prescaler (division factor of HCLK to produce PCLK2)"
default CLOCK_APB2_DIV_2

config CLOCK_APB2_DIV_1
    bool "Divide HCLK by 1"

config CLOCK_APB2_DIV_2
    bool "Divide HCLK by 2"

config CLOCK_APB2_DIV_4
    bool "Divide HCLK by 4"

config CLOCK_APB2_DIV_8
    bool "Divide HCLK by 8"

config CLOCK_APB2_DIV_16
    bool "Divide HCLK by 16"

endchoice

config CLOCK_APB2_DIV
    int
    default 1 if CLOCK_APB2_DIV_1
    default 2 if CLOCK_APB2_DIV_2
    default 4 if CLOCK_APB2_DIV_4
    default 8 if CLOCK_APB2_DIV_8
    default 16 if CLOCK_APB2_DIV_16

endmenu

source "$(RIOTBOARD)/common/stm32/Kconfig"
```
