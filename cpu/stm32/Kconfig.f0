## cpu/stm32/Kconfig.l4
```kconfig
# Copyright (c) 2020 Inria
#
# This file is subject to the terms and conditions of the GNU Lesser
# General Public License v2.1. See the file LICENSE in the top level
# directory for more details.
#

config CPU_FAM_L4
    bool
    select CPU_STM32
    select CPU_CORE_CORTEX_M4F
    select HAS_CPU_STM32L4
    select HAS_CORTEXM_MPU
    select HAS_PERIPH_FLASHPAGE
    select HAS_PERIPH_FLASHPAGE_RAW
    select HAS_PERIPH_HWRNG

# CPU lines
config CPU_LINE_STM32L4A6XX
    bool
    select CPU_FAM_L4

config CPU_LINE_STM32L4P5XX
    bool
    select CPU_FAM_L4

config CPU_LINE_STM32L4Q5XX
    bool
    select CPU_FAM_L4

config CPU_LINE_STM32L4R5XX
    bool
    select CPU_FAM_L4

config CPU_LINE_STM32L4R7XX
    bool
    select CPU_FAM_L4

config CPU_LINE_STM32L4R9XX
    bool
    select CPU_FAM_L4

config CPU_LINE_STM32L4S5XX
    bool
    select CPU_FAM_L4

config CPU_LINE_STM32L4S7XX
    bool
    select CPU_FAM_L4

config CPU_LINE_STM32L4S9XX
    bool
    select CPU_FAM_L4

config CPU_LINE_STM32L412XX
    bool
    select CPU_FAM_L4

config CPU_LINE_STM32L422XX
    bool
    select CPU_FAM_L4

config CPU_LINE_STM32L431XX
    bool
    select CPU_FAM_L4

config CPU_LINE_STM32L432XX
    bool
    select CPU_FAM_L4

config CPU_LINE_STM32L433XX
    bool
    select CPU_FAM_L4

config CPU_LINE_STM32L442XX
    bool
    select CPU_FAM_L4

config CPU_LINE_STM32L443XX
    bool
    select CPU_FAM_L4

config CPU_LINE_STM32L451XX
    bool
    select CPU_FAM_L4

config CPU_LINE_STM32L452XX
    bool
    select CPU_FAM_L4

config CPU_LINE_STM32L462XX
    bool
    select CPU_FAM_L4

config CPU_LINE_STM32L471XX
    bool
    select CPU_FAM_L4

config CPU_LINE_STM32L475XX
    bool
    select CPU_FAM_L4

config CPU_LINE_STM32L476XX
    bool
    select CPU_FAM_L4

config CPU_LINE_STM32L485XX
    bool
    select CPU_FAM_L4

config CPU_LINE_STM32L486XX
    bool
    select CPU_FAM_L4

config CPU_LINE_STM32L496XX
    bool
    select CPU_FAM_L4

# CPU models
config CPU_MODEL_STM32L412KB
    bool
    select CPU_LINE_STM32L412XX

config CPU_MODEL_STM32L432KC
    bool
    select CPU_LINE_STM32L432XX

config CPU_MODEL_STM32L433RC
    bool
    select CPU_LINE_STM32L433XX

config CPU_MODEL_STM32L452RE
    bool
    select CPU_LINE_STM32L452XX

config CPU_MODEL_STM32L475VG
    bool
    select CPU_LINE_STM32L475XX

config CPU_MODEL_STM32L476RG
    bool
    select CPU_LINE_STM32L476XX

config CPU_MODEL_STM32L476VG
    bool
    select CPU_LINE_STM32L476XX

config CPU_MODEL_STM32L496AG
    bool
    select CPU_LINE_STM32L496XX

config CPU_MODEL_STM32L496ZG
    bool
    select CPU_LINE_STM32L496XX

config CPU_MODEL_STM32L4R5ZI
    bool
    select CPU_LINE_STM32L4R5XX
```

## cpu/stm32/include/periph/wl/Kconfig
```kconfig
# Copyright (c) 2021 Freie Universitaet Berlin
#
# This file is subject to the terms and conditions of the GNU Lesser
# General Public License v2.1. See the file LICENSE in the top level
# directory for more details.
#
menuconfig KCONFIG_USEMODULE_CPU_FAM_STM32WL_DEBUG
    bool "STM2WL Debugging"
    depends on CPU_MODEL_STM32WL55JC

if KCONFIG_USEMODULE_CPU_FAM_STM32WL_DEBUG

config STM32_WL55JC_SUBGHZ_DEBUG
     bool "Enable Hardware Debug Pins"
     help
        Enable Hardware debug pins. This would affect onboard peripherals such as SPI
        as the pins are multiplexed. For more information check Alternate Functions
        column in Table 19. STM32WL55/54xx pin definition of STM32WL55/54xx
        datasheet.

endif # KCONFIG_USEMODULE_CPU_FAM_STM32WL_DEBUG
```

## cpu/stm32/kconfig/f1/Kconfig.models
```kconfig
# Copyright (c) 2020 Inria
#
# This file is subject to the terms and conditions of the GNU Lesser
# General Public License v2.1. See the file LICENSE in the top level
# directory for more details.
#

# CPU models
config CPU_MODEL_STM32F103C8
    bool
    select CPU_FAM_F1

config CPU_MODEL_STM32F103CB
    bool
    select CPU_LINE_STM32F103XB

config CPU_MODEL_STM32F103RB
    bool
    select CPU_LINE_STM32F103XB

config CPU_MODEL_STM32F103RE
    bool
    select CPU_LINE_STM32F103XE
```

## cpu/stm32/kconfig/f4/Kconfig.models
```kconfig
# Copyright (c) 2020 Inria
#
# This file is subject to the terms and conditions of the GNU Lesser
# General Public License v2.1. See the file LICENSE in the top level
# directory for more details.
#

# CPU models
config CPU_MODEL_STM32F401RE
    bool
    select CPU_LINE_STM32F401XE

config CPU_MODEL_STM32F405RG
    bool
    select CPU_LINE_STM32F405XX

config CPU_MODEL_STM32F407VG
    bool
    select CPU_LINE_STM32F407XX

config CPU_MODEL_STM32F410RB
    bool
    select CPU_LINE_STM32F410RX

config CPU_MODEL_STM32F411RE
    bool
    select CPU_LINE_STM32F411XE

config CPU_MODEL_STM32F411CEU6
    bool
    select CPU_LINE_STM32F411XE

config CPU_MODEL_STM32F412ZG
    bool
    select CPU_LINE_STM32F412ZX

config CPU_MODEL_STM32F413ZH
    bool
    select CPU_LINE_STM32F413XX

config CPU_MODEL_STM32F415RG
    bool
    select CPU_LINE_STM32F415XX

config CPU_MODEL_STM32F429ZI
    bool
    select CPU_LINE_STM32F429XX

config CPU_MODEL_STM32F437VG
    bool
    select CPU_LINE_STM32F437XX

config CPU_MODEL_STM32F446RE
    bool
    select CPU_LINE_STM32F446XX

config CPU_MODEL_STM32F446ZE
    bool
    select CPU_LINE_STM32F446XX
```

## cpu/stm32/kconfig/f7/Kconfig.models
```kconfig
# Copyright (c) 2020 Inria
#
# This file is subject to the terms and conditions of the GNU Lesser
# General Public License v2.1. See the file LICENSE in the top level
# directory for more details.
#

# CPU models
config CPU_MODEL_STM32F722ZE
    bool
    select CPU_LINE_STM32F722XX

config CPU_MODEL_STM32F723IE
    bool
    select CPU_LINE_STM32F723XX

config CPU_MODEL_STM32F746ZG
    bool
    select CPU_LINE_STM32F746XX

config CPU_MODEL_STM32F767ZI
    bool
    select CPU_LINE_STM32F767XX

config CPU_MODEL_STM32F769NI
    bool
    select CPU_LINE_STM32F769XX
```

## cpu/stm32/kconfig/l1/Kconfig.models
```kconfig
# Copyright (c) 2020 Inria
#
# This file is subject to the terms and conditions of the GNU Lesser
# General Public License v2.1. See the file LICENSE in the top level
# directory for more details.
#

# CPU models
config CPU_MODEL_STM32L151CB
    bool
    select CPU_LINE_STM32L151XB

config CPU_MODEL_STM32L151CB_A
    bool
    select CPU_LINE_STM32L151XBA

config CPU_MODEL_STM32L151RC
    bool
    select CPU_LINE_STM32L151XC

config CPU_MODEL_STM32L152RE
    bool
    select CPU_LINE_STM32L152XE
```

## drivers/bq2429x/Kconfig
```kconfig
# Copyright (C) 2020 Locha Inc
#
# This file is subject to the terms and conditions of the GNU Lesser
# General Public License v2.1. See the file LICENSE in the top level
# directory for more details.
#

config MODULE_BQ2429X
    bool "BQ2429x"
    depends on HAS_PERIPH_I2C
    depends on HAS_PERIPH_GPIO
    depends on TEST_KCONFIG
    select MODULE_PERIPH_I2C
    select MODULE_PERIPH_GPIO
    default y if HAVE_BQ2429X

config MODULE_BQ2429X_INT
    bool "BQ2429x with interrupt functionality"
    depends on HAS_PERIPH_GPIO_IRQ
    select MODULE_PERIPH_GPIO_IRQ
    select MODULE_BQ2429X
    default y if HAVE_BQ2429X_INT

config HAVE_BQ2429X
    bool
    help
        Indicates that a BQ2429x charger and power management IC is present.

config HAVE_BQ2429X_INT
    bool
    help
        Indicates that a BQ2429x charger and power management IC is present,
        with interrupt functionality (the INT pin is connected).
```

## drivers/llcc68/Kconfig
```kconfig
# Copyright (c) 2021 Inria
#
# This file is subject to the terms and conditions of the GNU Lesser
# General Public License v2.1. See the file LICENSE in the top level
# directory for more details.
#

config MODULE_LLCC68
    bool "LLCC68 LoRa Sub-GHz radio"
    depends on HAS_PERIPH_GPIO_IRQ
    depends on TEST_KCONFIG
    select MODULE_PERIPH_GPIO_IRQ
    select MODULE_IOLIST
```

## drivers/opt3001/Kconfig
```kconfig
# Copyright (c) 2020 Freie Universitaet Berlin
#
# This file is subject to the terms and conditions of the GNU Lesser
# General Public License v2.1. See the file LICENSE in the top level
# directory for more details.
#
menuconfig KCONFIG_MODULE_OPT3001
    bool "Configure OPT3001 driver"
    depends on MODULE_OPT3001
    help
        Configure the OPT3001 driver using Kconfig.

if KCONFIG_MODULE_OPT3001

config OPT3001_I2C_ADDRESS
    hex "Default I2C address"
    range 0x44 0x47
    default 0x45
    help
        The OPT3001 allows up to 4 devices on single bus. The address depends on
        the state of ADDR Pin. The default value (0x45) corresponds to ADDR pin
        tied to VDD. For more information check the I2C Address Selection
        (7.3.4.1) section in the Datasheet.

choice
    bool "OPT3001 conversion time"
    default OPT3001_CONVERSION_TIME_800
    help
        OPT3001 is capable of integrating results over either 100 ms or 800 ms
        time periods.

config OPT3001_CONVERSION_TIME_100
    bool "100 ms"

config OPT3001_CONVERSION_TIME_800
    bool "800 ms"

endchoice

endif # KCONFIG_MODULE_OPT3001
```

## pkg/driver_llcc68/Kconfig
```kconfig
config PACKAGE_DRIVER_LLCC68
    bool "LLCC68 driver package"
    depends on TEST_KCONFIG
    depends on HAS_PERIPH_SPI
    select MODULE_PERIPH_SPI
    select MODULE_FMT
    select MODULE_ZTIMER
    select MODULE_ZTIMER_USEC
    select MODULE_DRIVER_LLCC68_HAL

config MODULE_DRIVER_LLCC68_HAL
    bool
    help
        HAL implementation for the LLCC68 LoRa radio driver.
```

## pkg/tiny-asn1/Kconfig
```kconfig
# Copyright (c) 2021 HAW Hamburg
#
# This file is subject to the terms and conditions of the GNU Lesser
# General Public License v2.1. See the file LICENSE in the top level
# directory for more details.
#

config PACKAGE_TINY_ASN1
    depends on TEST_KCONFIG
    bool "ASN.1 decoding/encoding package"
```

## pkg/tlsf/Kconfig
```kconfig
# Copyright (c) 2021 HAW Hamburg
#
# This file is subject to the terms and conditions of the GNU Lesser
# General Public License v2.1. See the file LICENSE in the top level
# directory for more details.
#

config PACKAGE_TLSF
    bool "TLFS malloc/realloc/free/etc package"
    depends on TEST_KCONFIG
    depends on HAS_ARCH_32BIT
    select MODULE_TLSF_MALLOC_NEWLIB if MODULE_TLSF_MALLOC && MODULE_NEWLIB
    select MODULE_TLSF_MALLOC_NATIVE if MODULE_TLSF_MALLOC && BOARD_NATIVE
    help
        TLSF provides an implementation of malloc/realloc/free/etc.

config MODULE_TLSF_MALLOC
    bool "TLSF malloc"
    depends on TEST_KCONFIG

config MODULE_TLSF_MALLOC_NEWLIB
    bool
    depends on TEST_KCONFIG

config MODULE_TLSF_MALLOC_NATIVE
    bool
    depends on TEST_KCONFIG
```

## sys/congure/test/Kconfig
```kconfig
# Copyright (c) 2021 Freie Universität Berlin
#
# This file is subject to the terms and conditions of the GNU Lesser
# General Public License v2.1. See the file LICENSE in the top level
# directory for more details.

menuconfig KCONFIG_USEMODULE_CONGURE_TEST
    bool "Configure CongURE test framework"
    depends on USEMODULE_CONGURE_TEST
    help
        Configure CongURE test framework via Kconfig.

if KCONFIG_USEMODULE_CONGURE_TEST
config CONGURE_TEST_LOST_MSG_POOL_SIZE
    int "Pool size for the list elements for a lost message report"
    default 4
    help
        @see congure_snd_driver_t::report_msg_lost
        This defines the maximum number of 3-tuples you can use with
        @ref congure_test_call_report() when argv[1] is msg_lost.
endif   # KCONFIG_USEMODULE_CONGURE_TEST

menuconfig MODULE_CONGURE_TEST
    bool "CongURE test framework"
    depends on TEST_KCONFIG
    select MODULE_FMT

if MODULE_CONGURE_TEST

config CONGURE_TEST_LOST_MSG_POOL_SIZE
    int "Pool size for the list elements for a lost message report"
    default 4
    help
        @see congure_snd_driver_t::report_msg_lost
        This defines the maximum number of 3-tuples you can use with
        @ref congure_test_call_report() when argv[1] is msg_lost.

endif   # MODULE_CONGURE_TEST
```

## sys/net/gnrc/application_layer/dhcpv6/Kconfig
```kconfig
menuconfig KCONFIG_MODULE_GNRC_DHCPV6
    bool "Configure GNRC-part of DHCPv6"
    depends on MODULE_GNRC_DHCPV6
    help
        Configure GNRC-part of DHCPv6 via Kconfig.

if KCONFIG_MODULE_GNRC_DHCPV6

if MODULE_GNRC_DHCPV6_CLIENT_6LBR
config GNRC_DHCPV6_CLIENT_6LBR_UPSTREAM
    int "Identifier for the upstream interface of the 6LoWPAN border router"
    default 0
    help
        Leave 0 to let the client pic the first non-6LoWPAN interface it fins
endif # MODULE_GNRC_DHCPV6_CLIENT_6LBR

endif # KCONFIG_MODULE_GNRC_DHCPV6
```

## sys/net/gnrc/pktdump/Kconfig
```kconfig
# Copyright (c) 2020 Freie Universitaet Berlin
#
# This file is subject to the terms and conditions of the GNU Lesser
# General Public License v2.1. See the file LICENSE in the top level
# directory for more details.
#
menuconfig KCONFIG_MODULE_GNRC_PKTDUMP
    bool "Configure GNRC_PKTDUMP"
    depends on MODULE_GNRC_PKTDUMP
    help
        Configure the GNRC_PKTDUMP using Kconfig.

if KCONFIG_MODULE_GNRC_PKTDUMP

config GNRC_PKTDUMP_MSG_QUEUE_SIZE_EXP
    int "Queue size (as exponent of 2^n)"
    default 4
    help
        Message queue size for the pktdump thread. Value represents the
        exponent n of 2^n.

endif # KCONFIG_MODULE_GNRC_PKTDUMP
```

## sys/trace/Kconfig
```kconfig
# Copyright (c) 2021 HAW Hamburg
#
# This file is subject to the terms and conditions of the GNU Lesser
# General Public License v2.1. See the file LICENSE in the top level
# directory for more details.
#

if TEST_KCONFIG
config MODULE_TRACE
    bool "Execution tracing"
    select MODULE_XTIMER

if MODULE_TRACE
rsource "Kconfig.config"
endif # MODULE_TRACE

endif # TEST_KCONFIG

if !TEST_KCONFIG
menuconfig KCONFIG_USEMODULE_TRACE
    bool "Configure the trace module using Kconfig"
    depends on USEMODULE_TRACE

if KCONFIG_USEMODULE_TRACE
rsource "Kconfig.config"
endif # KCONFIG_USEMODULE_TRACE

endif # !TEST_KCONFIG
```

## sys/trace/Kconfig.config
```kconfig
# Copyright (c) 2021 HAW Hamburg
#
# This file is subject to the terms and conditions of the GNU Lesser
# General Public License v2.1. See the file LICENSE in the top level
# directory for more details.
#

# XXX This file only is required since there is no easy way to use these config
# options with both the final module and kconfig module in a
# nicely looking and easy to migrate way. After migration, the content of this
# file can be folded back into the Kconfig.

config TRACE_BUFSIZE
    int "Trace buffer size"
    default 512
```
